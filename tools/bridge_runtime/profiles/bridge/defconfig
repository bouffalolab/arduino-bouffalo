## tools/runtime_bundle/defconfig
```kconfig
CONFIG_NEWLIB               =n
CONFIG_NEWLIB_STANDARD      =n

CONFIG_VSNPRINTF_NANO       =n
CONFIG_VSNPRINTF_FLOAT      =n
CONFIG_VSNPRINTF_FLOAT_EX   =n
CONFIG_VSNPRINTF_LONG_LONG  =y
CONFIG_SCANF_FLOAT          =n
CONFIG_SCANF_FLOAT_EX       =n

CONFIG_BFLB_LOG             =n
CONFIG_FREERTOS             =y
CONFIG_BACKTRACE            =n
CONFIG_COREDUMP              =n
CONFIG_PSRAM                =n
CONFIG_RF                   =y
CONFIG_SHELL                =y
CONFIG_BTBLE_ENABLE         =y
CONFIG_BLUETOOTH            =y
CONFIG_BTBLECONTROLLER_LIB  =m2s1
CONFIG_BLE_USE_MAC2         =n
CONFIG_CHERRYUSB            =y
CONFIG_CHERRYUSB_OSAL       =freertos
CONFIG_CHERRYUSB_DEVICE     =y
CONFIG_CHERRYUSB_DEVICE_CDC_ACM=y
CONFIG_CHERRYUSB_DEVICE_HID =y
CONFIG_PEC_V2               =n
CONFIG_MULTIMEDIA_VIDEO     =n
CONFIG_GCC_COMPILE_LTO      =n
CONFIG_TLSF                 =y
CONFIG_DEBUG                =y
CONFIG_ROMAPI               =y
CONFIG_LOG_LEVEL            =3
CONFIG_CONSOLE_UART_BAUDRATE=2000000
CONFIG_STRICT               =n

# WiFi6 / IP stack (mirrors the SDK wifi example configuration)
CONFIG_POSIX                =y
CONFIG_LWIP                 =y
CONFIG_MBEDTLS              =y
CONFIG_DHCPD                =y
CONFIG_PING                 =y
CONFIG_WIFI6                =y
CONFIG_MACSW_SELECT         =default
CONFIG_FHOST                =y
CONFIG_VSNPRINTF_FLOAT      =y
CONFIG_VSNPRINTF_FLOAT_EX   =y
CONFIG_MBEDTLS_AES_USE_HW   =y
CONFIG_MBEDTLS_BIGNUM_USE_HW=y
CONFIG_MBEDTLS_ECC_USE_HW   =y
CONFIG_MBEDTLS_SHA1_USE_HW  =y
CONFIG_MBEDTLS_SHA256_USE_HW=y
CONFIG_MBEDTLS_SHA512_USE_HW=y
```
